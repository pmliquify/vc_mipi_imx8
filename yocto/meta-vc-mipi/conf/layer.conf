## yocto/meta-vc-mipi/conf/layer.conf
```bitbake
# We have a conf and classes directory, add to BBPATH
BBPATH .= ":${LAYERDIR}"

# We have recipes-* directories, add to BBFILES
BBFILES += "${LAYERDIR}/recipes-*/*/*.bb \
            ${LAYERDIR}/recipes-*/*/*.bbappend"

BBFILE_COLLECTIONS += "meta-vc-mipi"
BBFILE_PATTERN_meta-vc-mipi = "^${LAYERDIR}/"
BBFILE_PRIORITY_meta-vc-mipi = "6"

LAYERDEPENDS_meta-vc-mipi = "core"
LAYERSERIES_COMPAT_meta-vc-mipi = "dunfell"
```
